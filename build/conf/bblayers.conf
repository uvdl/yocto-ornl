## build/conf/bblayers.conf
```bitbake
LCONF_VERSION = "7"

BBPATH = "${TOPDIR}"
BSPDIR := "${@os.path.abspath(os.path.dirname(d.getVar('FILE', True)) + '/../..')}"

BBFILES ?= ""
BBLAYERS = " \
  ${BSPDIR}/sources/poky/meta \
  ${BSPDIR}/sources/poky/meta-poky \
  \
  ${BSPDIR}/sources/meta-openembedded/meta-oe \
  ${BSPDIR}/sources/meta-openembedded/meta-multimedia \
  \
  ${BSPDIR}/sources/meta-freescale \
  ${BSPDIR}/sources/meta-freescale-3rdparty \
  ${BSPDIR}/sources/meta-freescale-distro \
  \
  ${BSPDIR}/sources/meta-openembedded/meta-networking \
  ${BSPDIR}/sources/meta-openembedded/meta-python \
  ${BSPDIR}/sources/meta-openembedded/meta-webserver \
  ${BSPDIR}/sources/meta-qt5 \
  ${BSPDIR}/sources/meta-swupdate \
  ${BSPDIR}/sources/meta-variscite-fslc \
  ${BSPDIR}/sources/meta-ornl \
"

python() {
  bspDir = d.getVar("BSPDIR", True)
  if d.getVar('DISTRO_CODENAME', True) == "dunfell":
    d.appendVar("BBLAYERS", " %s/sources/meta-python2 " % bspDir)
}
```

## build/conf/local.conf
```bitbake
MACHINE ??= 'var-som-mx6-ornl'
DISTRO ?= 'fslc-framebuffer'

# The default package class will be apt-get, this only specifies it
# individual images can choose to add or not to add by adding package-management to 
# IMAGE_FEATURE variable
PACKAGE_CLASSES ?= "package_ipk"

# Debug-tweaks is needed for all images for at the minimum of structuring the root passwords.
EXTRA_IMAGE_FEATURES ?= "debug-tweaks"
USER_CLASSES ?= "buildstats image-mklibs image-prelink"
PATCHRESOLVE = "noop"
LICENSE_FLAGS_WHITELIST += "commercial_vo-aacenc commercial_x265"

# Used for monitoring Disk space during the build. See Yocto Reference Manual for more info.
BB_DISKMON_DIRS ??= "\
    STOPTASKS,${TMPDIR},1G,100K \
    STOPTASKS,${DL_DIR},1G,100K \
    STOPTASKS,${SSTATE_DIR},1G,100K \
    STOPTASKS,/tmp,100M,100K \
    ABORT,${TMPDIR},100M,1K \
    ABORT,${DL_DIR},100M,1K \
    ABORT,${SSTATE_DIR},100M,1K \
    ABORT,/tmp,10M,1K"

# Needed for the host machine build
PACKAGECONFIG_append_pn-qemu-native = " sdl"
PACKAGECONFIG_append_pn-nativesdk-qemu = " sdl"
CONF_VERSION = "1"
# Rather ridiculous but this accepts an EULA from Freescale/NXP
ACCEPT_FSL_EULA = "1"

IMAGE_FSTYPES_remove_var-som-mx6-ornl = "ubi multiubi"

# http://lists.openembedded.org/pipermail/openembedded-core/2013-November/086898.html
#PARALLEL_MAKE ?= "-j ${GB}"
#BB_NUMBER_THREADS ?= "${CPUS}"

PREFERRED_VERSION_linux = "4.9.88"

# Needed to build Systemd into all our images
DISTRO_FEATURES_append = " systemd pam"
DISTRO_FEATURES_remove = " nfs"
VIRTUAL-RUNTIME_init_manager = "systemd"
DISTRO_FEATURES_BACKFILL_CONSIDERED = "pulseaudio sysvinit bluez5 nfs"
VIRTUAL-RUNTIME_initscripts = ""
VOLATILE_LOG_DIR = "no"

# https://wiki.yoctoproject.org/wiki/Setting_up_a_local_instance_of_Toaster
INHERIT+="toaster buildhistory"
BUILDHISTORY_COMMIT = "1"
```

## sources/meta-ornl/conf/distro/ornl-rpi.conf
```bitbake
# Needed to build Systemd into all our images
DISTRO_FEATURES_append = " systemd pam opengl"
VIRTUAL-RUNTIME_init_manager = "systemd"
DISTRO_FEATURES_BACKFILL_CONSIDERED = " sysvinit nfs"
DISTRO_FEATURES_remove = " nfs"
VIRTUAL-RUNTIME_initscripts = ""
VOLATILE_LOG_DIR = "no"

# IMPORTANT : This determines the overall size of the rootfs partition
# Set now to give us 8 GB (more) headroom.  Number KB.
IMAGE_ROOTFS_EXTRA_SPACE = "8388608"

MACHINE_FEATURES_append_raspberrypi4 += " libegl-mesa"

# Need nmcli for our distrobution
NETWORK_MANAGER ?= "networkmanager"

PREFERRED_VERSION_python3-pyserial = "3.5"

# Need this wic file in order to hold the partitions
WKS_FILE = "sdimage-raspberrypi.wks"

IMAGE_FSTYPES += "tar.gz ext4.gz"

#.Net Core specifics
PREFERRED_VERSION_dotnet-core ?= "6.0.200"
PREFERRED_VERSION_vsdbg ?= "16.8.11005.1"
PACKAGECONFIG_pn-curl = "vers krb5 ssl zlib ipv6"

RPI_USE_U_BOOT = "1"
# For serial console
ENABLE_UART = "1"
# start_x
VIDEO_CAMERA = "1"
# DWC2 Host Mode
ENABLE_DWC2_HOST = "1"
GPU_MEM = "128"
# ENable I2C on RPIs
ENABLE_I2C = "1"
KERNEL_MODULE_AUTOLOAD_rpi += " i2c-dev i2c-bcm2708"

# These are config.txt extras needed for our hardware support
# TODO : add rpi-config_git.bbappend to add a switch for MIPI camera
# support. And move these over to it...

# These need to be considered if used on per project or always
# RPI_EXTRA_CONFIG += " \    
# dtparam=audio=on \n \
# dtparam=i2c_vc=on \n \
# dtoverlay=audremap,pins_18_19 \n \
# dtoverlay=i2c-rtc,pcf8523,i2c_csi_dsi \n \
# gpio=11,12=ip \n \
# gpio=10=op,dh \n \
# dtoverlay=ov5647 \n \
# "
```

## sources/meta-ornl/conf/distro/ornl-variscite.conf
```bitbake
MAINTAINER = "UVDL team"

# Needed to build Systemd into all our images
DISTRO_FEATURES_append = " systemd pam"
VIRTUAL-RUNTIME_init_manager = "systemd"
DISTRO_FEATURES_BACKFILL_CONSIDERED = " sysvinit nfs"
DISTRO_FEATURES_remove = " nfs"
VIRTUAL-RUNTIME_initscripts = ""
VOLATILE_LOG_DIR = "no"

LOCALCONF_VERSION = "1"

# Need nmcli for our distrobution
NETWORK_MANAGER ?= "networkmanager"

PREFERRED_VERSION_python3-pyserial = "3.5"

#.Net Core specifics
PREFERRED_VERSION_dotnet-core ?= "6.0.200"
PREFERRED_VERSION_vsdbg ?= "16.8.11005.1"
PACKAGECONFIG_pn-curl = "vers krb5 ssl zlib ipv6"

TCLIBCAPPEND = ""

PREMIRRORS ??= "\
bzr://.*/.*   http://downloads.yoctoproject.org/mirror/sources/ \n \
cvs://.*/.*   http://downloads.yoctoproject.org/mirror/sources/ \n \
git://.*/.*   http://downloads.yoctoproject.org/mirror/sources/ \n \
gitsm://.*/.* http://downloads.yoctoproject.org/mirror/sources/ \n \
hg://.*/.*    http://downloads.yoctoproject.org/mirror/sources/ \n \
osc://.*/.*   http://downloads.yoctoproject.org/mirror/sources/ \n \
p4://.*/.*    http://downloads.yoctoproject.org/mirror/sources/ \n \
svn://.*/.*   http://downloads.yoctoproject.org/mirror/sources/ \n"

SANITY_TESTED_DISTROS ?= " \
    ubuntu-18.04 \n \
    ubuntu-20.04 \n \
"

# We should always expect systemd
INIT_MANAGER = "systemd"

#
# OELAYOUT_ABI allows us to notify users when the format of TMPDIR changes in
# an incompatible way. Such changes should usually be detailed in the commit
# that breaks the format and have been previously discussed on the mailing list
# with general agreement from the core team.
#
OELAYOUT_ABI = "12"

require conf/distro/include/no-static-libs.inc
require conf/distro/include/yocto-uninative.inc
require conf/distro/include/security_flags.inc

INHERIT += "uninative"
INHERIT += "reproducible_build"
# add poky sanity bbclass
INHERIT += "poky-sanity"

BB_SIGNATURE_HANDLER ?= "OEEquivHash"
BB_HASHSERVE ??= "auto"

# QA check settings - a little stricter than the OE-Core defaults
WARN_QA = "textrel files-invalid incompatible-license xorg-driver-abi libdir \
           unknown-configure-option version-going-backwards"
ERROR_QA = "dev-so debug-deps dev-deps debug-files arch pkgconfig la perms \
            useless-rpaths rpaths staticdev ldflags pkgvarcheck already-stripped \
            compile-host-path dep-cmp installed-vs-shipped install-host-path \
            packages-list perm-config perm-line perm-link pkgv-undefined \
            pn-overrides split-strip var-undefined "

LICENSE_FLAGS_WHITELIST += "commercial_faad2"
```

## sources/meta-ornl/conf/layer.conf
```bitbake
# We have a conf and classes directory, add to BBPATH
BBPATH .= ":${LAYERDIR}"

# We have recipes-* directories, add to BBFILES
BBFILES += "${LAYERDIR}/recipes-*/*/*.bb \
            ${LAYERDIR}/recipes-*/*/*.bbappend"

BBFILES_DYNAMIC += " \
    swupdate:${LAYERDIR}/dynamic-layers/swupdate/*.bb \
    swupdate:${LAYERDIR}/dynamic-layers/swupdate/*.bbappend \
    \
    raspberrypi:${LAYERDIR}/dynamic-layers/raspberrypi/recipes-extended/images/*.bb \
    \
    variscite:${LAYERDIR}/dynamic-layers/variscite/recipes-extended/images/*.bb \
"

BBFILE_COLLECTIONS += "meta-ornl"
BBFILE_PATTERN_meta-ornl = "^${LAYERDIR}/"
BBFILE_PRIORITY_meta-ornl = "10"

LAYERSERIES_COMPAT_meta-ornl = "dunfell gatesgarth"

HOSTTOOLS += " \
    cc dos2unix seq \
"
```

## sources/meta-ornl/conf/machine/var-som-mx6-ornl.conf
```bitbake
#@TYPE: Machine
#@NAME: Variscite VAR-SOM-MX6
#@SOC: i.MX6Q/D/DL/S
#@DESCRIPTION: Machine configuration for Variscite VAR-SOM-MX6 VAR-SOM-SOLO/DUAL DART-MX6
#@MAINTAINER: Eran Matityahu <eran.m@variscite.com>
#
# http://www.variscite.com

MACHINEOVERRIDES =. "mx6:mx6dl:mx6q:var-som-mx6:"
include conf/machine/include/imx-base.inc
include conf/machine/include/tune-cortexa9.inc
include conf/machine/include/ornl.inc

SERIAL_CONSOLE = "115200 ttymxc0"

KERNEL_IMAGETYPE = "uImage"
KERNEL_DEVICETREE = " \
		     imx6q-var-dart.dtb \
		     imx6q-iris2-R0.dtb \
		     imx6q-iris2-R1.dtb \
		     imx6q-nightcrawler-R0.dtb \
"

SOC_DEFAULT_WKS_FILE = "imx-uboot-spl-bootpart.wks.in"

IMAGE_BOOT_FILES = " \
	${KERNEL_IMAGETYPE} \
	${KERNEL_DEVICETREE} \
"

UBOOT_MAKE_TARGET = ""
SPL_BINARY          = "SPL"
UBOOT_SUFFIX        = "img"
UBOOT_CONFIG ??= "nand sd "
# The above order matters. The last one will be also called u-boot-${MACHINE} and will be used to create the sdcard.
UBOOT_CONFIG[sd] = "mx6var_som_sd_config,sdcard"
UBOOT_CONFIG[nand] = "mx6var_som_nand_config,ubifs"

UBOOT_ENTRYPOINT = "0x10008000"
UBOOT_LOADADDRESS = "0x10008000"

MACHINE_EXTRA_RDEPENDS += " \
			   linux-firmware-wl18xx \
			   wl18xx-target-scripts \
			   wlconf \
"
```
